/dts-v1/;
/plugin/;

#include <dt-bindings/clock/qcom,gcc-kona.h>
#include <dt-bindings/clock/qcom,camcc-kona.h>
#include <dt-bindings/clock/qcom,rpmh.h>
#include <dt-bindings/interrupt-controller/arm-gic.h>

#include "kona-mtp.dtsi"
#include "kona-oem.dtsi"
#include "instantnoodle.dtsi"
#include "instantnoodle_evt1.dtsi"
#include "camera/kona-oem-camera-instantnoodle.dtsi"

/ {
    /* HOWSON-evt1 specific overlay */
};

fragment@0 {
    target-path = "/";
    __overlay__ {
        model = "Qualcomm Technologies, Inc. kona MTP evt1 19821 19855 12 13";
        compatible = "qcom,kona-mtp", "qcom,kona", "qcom,mtp";
        qcom,board-id = <8 0>;
        oem,project-id = <19821 19855>;
        oem,hw-id = <12 13 54>;
    };
};
