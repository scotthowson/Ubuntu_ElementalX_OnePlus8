/dts-v1/;
/plugin/;

#include <dt-bindings/clock/qcom,gcc-kona.h>
#include <dt-bindings/clock/qcom,camcc-kona.h>
#include <dt-bindings/clock/qcom,rpmh.h>
#include <dt-bindings/interrupt-controller/arm-gic.h>

#include "kona-mtp.dtsi"
#include "kona-oem.dtsi"
#include "instantnoodlep.dtsi"
#include "instantnoodlep_dvt.dtsi"
#include "camera/kona-oem-camera-instantnoodlep_t0.dtsi"

/ {
    /* HOWSON-lep-dvt specific overlay */
};

fragment@0 {
    target-path = "/";
    __overlay__ {
        model = "Qualcomm Technologies, Inc. kona MTP dvt/mp 19811 14 15 52 53";
        compatible = "qcom,kona-mtp", "qcom,kona", "qcom,mtp";
        qcom,board-id = <8 0>;
        oem,project-id = <19811>;
        oem,hw-id = <14 15 52 53>;
    };
};
