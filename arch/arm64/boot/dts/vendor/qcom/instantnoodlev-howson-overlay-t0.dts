/dts-v1/;
/plugin/;

#include <dt-bindings/clock/qcom,gcc-kona.h>
#include <dt-bindings/clock/qcom,camcc-kona.h>
#include <dt-bindings/clock/qcom,rpmh.h>
#include <dt-bindings/interrupt-controller/arm-gic.h>

#include "kona-mtp.dtsi"
#include "kona-oem.dtsi"
#include "instantnoodlev.dtsi"
#include "instantnoodlev_t0.dtsi"
#include "camera/kona-oem-camera-instantnoodlev.dtsi"

/ {
    /* HOWSON-lev-t0 specific overlay */
};

fragment@0 {
    target-path = "/";
    __overlay__ {
        model = "Qualcomm Technologies, Inc. kona MTP t0 19867 11";
        compatible = "qcom,kona-mtp", "qcom,kona", "qcom,mtp";
        qcom,board-id = <8 0>;
        oem,project-id = <19867>;
        oem,hw-id = <11>;
    };
};